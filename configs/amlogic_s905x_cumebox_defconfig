## configs/amlogic_s905x_cumebox_defconfig
```kconfig
BR2_aarch64=y
BR2_TOOLCHAIN_EXTERNAL=y
BR2_SYSTEM_DHCP="eth0"
BR2_ROOTFS_POST_BUILD_SCRIPT="board/amlogic/cumebox/post-build.sh"
BR2_ROOTFS_POST_IMAGE_SCRIPT="board/amlogic/cumebox/post-image.sh"
BR2_LINUX_KERNEL=y
BR2_LINUX_KERNEL_CUSTOM_GIT=y
BR2_LINUX_KERNEL_CUSTOM_REPO_URL="git@github.com:JinhuaW/linux-5.10.git"
BR2_LINUX_KERNEL_CUSTOM_REPO_VERSION="3cb1d73c04205c56a130b5f9bb3dd19aabdc8806"
BR2_LINUX_KERNEL_USE_CUSTOM_CONFIG=y
BR2_LINUX_KERNEL_CUSTOM_CONFIG_FILE="board/amlogic/linux-meson64-5.10.config"
BR2_LINUX_KERNEL_DTS_SUPPORT=y
BR2_LINUX_KERNEL_INTREE_DTS_NAME="amlogic/meson-gxl-s905x-cumebox"
BR2_LINUX_KERNEL_NEEDS_HOST_OPENSSL=y
BR2_TARGET_ROOTFS_EXT2=y
BR2_TARGET_ROOTFS_EXT2_4=y
BR2_TARGET_ROOTFS_EXT2_SIZE="200M"
# BR2_TARGET_ROOTFS_TAR is not set
BR2_PACKAGE_HOST_DOSFSTOOLS=y
BR2_PACKAGE_HOST_GENIMAGE=y
BR2_PACKAGE_HOST_MTOOLS=y
BR2_PACKAGE_HOST_UBOOT_TOOLS=y
```

## configs/qemu_arm_vexpress_defconfig
```kconfig
BR2_arm=y
BR2_cortex_a9=y
BR2_ARM_ENABLE_VFP=y
BR2_ARM_EABI=y
BR2_TOOLCHAIN_EXTERNAL=y
BR2_TOOLCHAIN_EXTERNAL_CUSTOM=y
BR2_TOOLCHAIN_EXTERNAL_DOWNLOAD=y
BR2_TOOLCHAIN_EXTERNAL_URL="https://raw.githubusercontent.com/JinhuaW/toolchain/master/arm-linux-toolchain2.tar.gz"
BR2_TOOLCHAIN_EXTERNAL_CUSTOM_PREFIX="arm-unknown-linux-gnueabi"
BR2_TOOLCHAIN_EXTERNAL_GCC_6=y
BR2_TOOLCHAIN_EXTERNAL_HEADERS_4_1=y
BR2_TOOLCHAIN_EXTERNAL_CUSTOM_GLIBC=y
BR2_TOOLCHAIN_EXTERNAL_CXX=y
BR2_TARGET_GENERIC_GETTY_PORT="ttyAMA0"
BR2_SYSTEM_DHCP="eth0"
BR2_LINUX_KERNEL=y
BR2_LINUX_KERNEL_CUSTOM_GIT=y
BR2_LINUX_KERNEL_CUSTOM_REPO_URL="https://github.com/JinhuaW/linux.git"
BR2_LINUX_KERNEL_CUSTOM_REPO_VERSION="816ce7f02c80ae7f34a74aaf2847dd99abc9fd70"
BR2_LINUX_KERNEL_USE_CUSTOM_CONFIG=y
BR2_LINUX_KERNEL_CUSTOM_CONFIG_FILE="board/qemu/arm-vexpress/qemu-vexpress.config"
BR2_LINUX_KERNEL_DTS_SUPPORT=y
BR2_LINUX_KERNEL_USE_CUSTOM_DTS=y
BR2_LINUX_KERNEL_CUSTOM_DTS_PATH="board/qemu/arm-vexpress/qemu-vexpress.dts"
BR2_PACKAGE_IOZONE=y
BR2_PACKAGE_MEMSTAT=y
BR2_PACKAGE_NETPERF=y
BR2_PACKAGE_STRACE=y
BR2_PACKAGE_E2FSPROGS=y
BR2_PACKAGE_LIBFUSE=y
BR2_PACKAGE_LIBNL=y
BR2_PACKAGE_LIBCLI=y
BR2_PACKAGE_NCURSES=y
BR2_PACKAGE_ETHTOOL=y
BR2_PACKAGE_IPTABLES=y
BR2_PACKAGE_FILE=y
BR2_PACKAGE_LINUX_DRIVERS=y
BR2_PACKAGE_TARGET_APPS=y
BR2_PACKAGE_TARGET_LIBS=y
BR2_PACKAGE_TARGET_LIBS_THREAD_POOL=y
BR2_TARGET_ROOTFS_EXT2=y
# BR2_TARGET_ROOTFS_TAR is not set
```

## package/SPE/Config.in
```kconfig
source package/SPE/linux-drivers/Config.in
source package/SPE/target-apps/Config.in
source package/SPE/target-libs/Config.in
```

## package/SPE/target-apps/Config.in
```kconfig
config BR2_PACKAGE_TARGET_APPS
	bool "Examples of target apps"
	select BR2_PACKAGE_LIBUIO
	default n
```

## package/SPE/target-libs/Config.in
```kconfig
config BR2_PACKAGE_TARGET_LIBS
	bool "Examples of target libs"
	default n

if BR2_PACKAGE_TARGET_LIBS
config BR2_PACKAGE_TARGET_LIBS_THREAD_POOL
	bool "Build the thread pool library"
endif
```

## package/SPE/target-test-apps/Config.in
```kconfig
config BR2_PACKAGE_TARGET_TEST_APPS
	bool "Examples of target test apps"
	default n
```
